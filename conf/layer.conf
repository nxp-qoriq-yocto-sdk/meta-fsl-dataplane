## conf/layer.conf
```bitbake
# We have a packages directory, add to BBFILES
BBPATH .= ":${LAYERDIR}"

BBFILES += "\
            ${LAYERDIR}/recipes-*/*/*.bb* \
            ${LAYERDIR}/images/*.bb* \
            ${LAYERDIR}/packagegroups/*.bb* \
           "

BBFILE_COLLECTIONS += "fsl-dataplane"
BBFILE_PATTERN_fsl-dataplane = "^${LAYERDIR}/"
BBFILE_PRIORITY_fsl-dataplane = "5"
```
